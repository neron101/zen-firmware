## config/west.yml
```yaml
manifest:
  remotes:
    - name: zmkfirmware
      url-base: https://github.com/zmkfirmware
    - name: cormoran
      url-base: https://github.com/cormoran
    - name: sekigon-gonnoc
      url-base: https://github.com/sekigon-gonnoc
    - name: kot149
      url-base: https://github.com/kot149
    - name: kumamuk-git
      url-base: https://github.com/kumamuk-git
    - name: badjeff
      url-base: https://github.com/badjeff
  projects:
    # ZMK本体（DYA Studio対応 cormoran版 v0.3）
    - name: zmk
      remote: cormoran
      revision: v0.3-branch+dya
      import: app/west.yml
    - name: zmk-component-bmp-boost
      remote: sekigon-gonnoc
      import: west.yml
      revision: v0.2
    - name: zmk-feature-status-led
      remote: sekigon-gonnoc
      revision: main
    - name: zmk-driver-paw3222
      remote: sekigon-gonnoc
      revision: torabo-tsuki
    - name: zmk-feature-cdc-acm-bootloader-trigger
      remote: sekigon-gonnoc
      revision: v0.2
    - name: zmk-feature-non-lipo-battery-management
      remote: sekigon-gonnoc
      revision: main
    - name: zmk-scroll-snap
      remote: kot149
      revision: v1
    # DYA Studio用モジュール（v0.3対応版）
    - name: zmk-module-ble-management
      remote: cormoran
      revision: zmk-v0.3.0.0
    - name: zmk-module-battery-history
      remote: cormoran
      revision: main
    - name: zmk-module-settings-rpc
      remote: cormoran
      revision: main
    - name: zmk-module-runtime-input-processor
      remote: cormoran
      revision: zmk-v0.3.0.0
  self:
    path: config
```
